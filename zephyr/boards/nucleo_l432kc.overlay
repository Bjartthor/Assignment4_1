#include <zephyr/dt-bindings/gpio/gpio.h>
/ { 
    aliases {
        sw1 = &user_button;
    };
    buttons {
        compatible = "gpio-keys";
        user_button: button_0 {
            gpios = <&gpiob 0 (GPIO_ACTIVE_LOW |GPIO_PULL_UP)>;
        };
    };
};